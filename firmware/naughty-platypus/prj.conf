## CMakeLists.txt
```
cmake_minimum_required(VERSION 3.20.0)

find_package(Zephyr REQUIRED HINTS $ENV{ZEPHYR_BASE})
project(naughty_platypus)

target_sources(app PRIVATE
    src/main.c
    src/tool_registry.c
    src/restricted_stubs.c
    src/passive_survey.c
    src/boot_splash.c
    src/boot_splash_image.c
)
```

## Kconfig
```
menu "Naughty Platypus Ubertooth-Style Lab Suite"

config NP_BOOT_SPLASH
    bool "Show the Naughty Platypus boot splash on the optional TFT"
    default y
    help
      Enables the 135x240 RGB565 boot splash for the optional Heltec T114
      ST7789V display. The firmware remains fully operational when the display
      node or hardware is unavailable; display failures are logged and ignored.

config NP_ENABLE_PASSIVE_SURVEY
    bool "Enable passive BLE advertisement survey"
    default y
    help
      Enables passive BLE advertisement observation, RSSI logging, and
      advertisement metadata parsing.

config NP_ENABLE_ADV_ANALYZER
    bool "Enable BLE advertisement analyzer"
    default y
    help
      Enables BLE advertisement metadata parsing for names, flags, TX power,
      manufacturer-data previews, and service-data previews.

config NP_ENABLE_RSSI_SURVEY
    bool "Enable RSSI survey counters"
    default y
    help
      Enables signal survey counters for lab positioning, antenna, and enclosure tests.

config NP_ENABLE_CHANNEL_SURVEY_PLACEHOLDER
    bool "Enable channel survey safe lab status"
    default y
    help
      Placeholder only. Standard Zephyr BLE observer mode is not a raw Ubertooth
      channel-hop sniffer.

config NP_ENABLE_BLE_CONNECTION_FOLLOW_PLACEHOLDER
    bool "Enable BLE connection-follow safe lab status"
    default y
    help
      Placeholder only. No connection-following or private-payload capture logic
      is included.

config NP_ENABLE_BLE_GATT_MUTATION_PLACEHOLDER
    bool "Enable GATT read-only audit status"
    default y
    help
      Placeholder only. No GATT fuzzing, mutation, or unauthorized write logic
      is included.

config NP_ENABLE_BLE_PAIRING_LAB_PLACEHOLDER
    bool "Enable pairing policy status check"
    default y
    help
      Placeholder only. No forced pairing, coercion, or credential capture logic
      is included.

config NP_ENABLE_BLE_ADV_TX_PLACEHOLDER
    bool "Enable local advertising self-test status"
    default y
    help
      Placeholder only. No spoofing, impersonation, flooding, or deceptive
      advertising behavior is included.

config NP_ENABLE_BLE_STABILITY_STRESS_PLACEHOLDER
    bool "Enable local firmware health self-test"
    default y
    help
      Placeholder only. No flooding, denial-of-service, or disruption logic is
      included.

config NP_ENABLE_CLASSIC_BT_PLACEHOLDER
    bool "Enable Bluetooth Classic placeholder"
    default n
    help
      Placeholder only. The nRF52840 is BLE-focused and does not provide a
      Bluetooth Classic BR/EDR sniffer equivalent to Ubertooth.

endmenu

source "Kconfig.zephyr"
```

## prj.conf
```kconfig
# Naughty Platypus: Ubertooth-style BLE lab suite for Heltec T114 / HT-n5262 / nRF52840.
#
# This build is NOT the normal Platypus BlueZ HCI firmware.
# It appears as a USB CDC ACM serial lab instrument and streams JSON events.
#
# Safe/default tools are enabled.
# Higher-risk tools are declared but intentionally disabled / stub-only.

CONFIG_BT=y
CONFIG_BT_OBSERVER=y
CONFIG_BT_DEVICE_NAME="Naughty Platypus"
CONFIG_BT_DEVICE_APPEARANCE=0

CONFIG_BT_BUF_EVT_RX_SIZE=255
CONFIG_BT_BUF_EVT_RX_COUNT=16

CONFIG_MAIN_STACK_SIZE=4096
CONFIG_SYSTEM_WORKQUEUE_STACK_SIZE=2048

CONFIG_SERIAL=y
CONFIG_CONSOLE=y
CONFIG_UART_CONSOLE=y
CONFIG_PRINTK=y

CONFIG_SHELL=y
CONFIG_SHELL_BACKEND_SERIAL=y
CONFIG_SHELL_PROMPT_UART="naughty-platypus> "

CONFIG_LOG=y
CONFIG_LOG_MODE_IMMEDIATE=y
CONFIG_LOG_DEFAULT_LEVEL=2

# Optional Heltec T114 ST7789V boot splash.
# The application still boots and scans when the display is absent or not ready.
CONFIG_GPIO=y
CONFIG_DISPLAY=y
CONFIG_ST7789V=y
CONFIG_NP_BOOT_SPLASH=y

# Safe/default lab tools.
CONFIG_NP_ENABLE_PASSIVE_SURVEY=y
CONFIG_NP_ENABLE_ADV_ANALYZER=y
CONFIG_NP_ENABLE_RSSI_SURVEY=y

# Restricted placeholders. These intentionally remain disabled.
# Purple activation docs are in docs/manual-activation-map.html.
CONFIG_NP_ENABLE_CHANNEL_SURVEY_PLACEHOLDER=y
CONFIG_NP_ENABLE_BLE_CONNECTION_FOLLOW_PLACEHOLDER=y
CONFIG_NP_ENABLE_BLE_GATT_MUTATION_PLACEHOLDER=y
CONFIG_NP_ENABLE_BLE_PAIRING_LAB_PLACEHOLDER=y
CONFIG_NP_ENABLE_BLE_ADV_TX_PLACEHOLDER=y
CONFIG_NP_ENABLE_BLE_STABILITY_STRESS_PLACEHOLDER=y
# CONFIG_NP_ENABLE_CLASSIC_BT_PLACEHOLDER is not set
CONFIG_USB_DEVICE_STACK_NEXT=y
CONFIG_CDC_ACM_SERIAL_INITIALIZE_AT_BOOT=y
CONFIG_STDOUT_CONSOLE=y
CONFIG_UART_LINE_CTRL=y
```

## src/main.c
```c
#include <zephyr/drivers/uart.h>
#include <zephyr/devicetree.h>
#include <zephyr/device.h>
#include <errno.h>
#include <stdio.h>

#include <zephyr/kernel.h>
#include <zephyr/sys/printk.h>
#include <zephyr/shell/shell.h>
#include <zephyr/bluetooth/bluetooth.h>

#if defined(CONFIG_USB_DEVICE_STACK)
#include <zephyr/usb/usb_device.h>
#endif

#include "boot_splash.h"
#include "passive_survey.h"
#include "tool_registry.h"

#define NP_FIRMWARE_BUILD "ble_active_splash_v6"

static bool bt_ready;

static int cmd_scan_on(const struct shell *sh, size_t argc, char **argv)
{
    ARG_UNUSED(argc);
    ARG_UNUSED(argv);

    int err = np_passive_survey_start();

    if (err) {
        shell_error(sh, "scan_on failed: %d", err);
        return err;
    }

    shell_print(sh, "BLE survey started");
    return 0;
}

static int cmd_scan_off(const struct shell *sh, size_t argc, char **argv)
{
    ARG_UNUSED(argc);
    ARG_UNUSED(argv);

    int err = np_passive_survey_stop();

    if (err) {
        shell_error(sh, "scan_off failed: %d", err);
        return err;
    }

    shell_print(sh, "BLE survey stopped");
    return 0;
}

static int cmd_status(const struct shell *sh, size_t argc, char **argv)
{
    ARG_UNUSED(argc);
    ARG_UNUSED(argv);

    shell_print(sh, "bt_ready=%s survey_running=%s display_ready=%s",
                bt_ready ? "yes" : "no",
                np_passive_survey_is_running() ? "yes" : "no",
                np_boot_splash_available() ? "yes" : "no");

    return np_passive_survey_status();
}

static int cmd_reset_stats(const struct shell *sh, size_t argc, char **argv)
{
    ARG_UNUSED(argc);
    ARG_UNUSED(argv);

    shell_print(sh, "survey counters reset");
    return np_passive_survey_reset();
}

static int cmd_splash(const struct shell *sh, size_t argc, char **argv)
{
    ARG_UNUSED(argc);
    ARG_UNUSED(argv);

    int err = np_boot_splash_show();

    if (err) {
        shell_warn(sh, "boot splash unavailable: %d", err);
    } else {
        shell_print(sh, "boot splash redrawn");
    }

    return err;
}

static int cmd_tools_list(const struct shell *sh, size_t argc, char **argv)
{
    ARG_UNUSED(argc);
    ARG_UNUSED(argv);

    uint32_t count = 0;
    const struct np_tool *tools = np_tools_get(&count);

    for (uint32_t i = 0; i < count; i++) {
        shell_print(sh,
                    "%s | enabled=%s | risk=%s | status=%s | %s",
                    tools[i].id,
                    tools[i].enabled ? "true" : "false",
                    np_risk_to_str(tools[i].risk),
                    np_status_to_str(tools[i].status),
                    tools[i].description);
    }

    return 0;
}

static int cmd_tools_run(const struct shell *sh, size_t argc, char **argv)
{
    if (argc < 2) {
        shell_error(sh, "usage: np tools_run <tool_id>");
        return -EINVAL;
    }

    int err = np_tool_run_by_id(argv[1]);

    if (err == -EPERM) {
        shell_error(sh, "tool disabled by build config: %s", argv[1]);
    } else if (err == -ENOTSUP) {
        shell_error(sh, "tool is stub-only / not implemented: %s", argv[1]);
    } else if (err == -ENOENT) {
        shell_error(sh, "unknown tool: %s", argv[1]);
    } else if (err) {
        shell_error(sh, "tool failed: %d", err);
    }

    return err;
}

SHELL_STATIC_SUBCMD_SET_CREATE(sub_np,
    SHELL_CMD(scan_on, NULL, "Start BLE advertisement survey", cmd_scan_on),
    SHELL_CMD(scan_off, NULL, "Stop BLE advertisement survey", cmd_scan_off),
    SHELL_CMD(status, NULL, "Show survey status and counters", cmd_status),
    SHELL_CMD(reset_stats, NULL, "Reset survey counters", cmd_reset_stats),
    SHELL_CMD(splash, NULL, "Redraw the optional boot splash", cmd_splash),
    SHELL_CMD(tools_list, NULL, "List safe and restricted tool registry", cmd_tools_list),
    SHELL_CMD(tools_run, NULL, "Run enabled tool by ID", cmd_tools_run),
    SHELL_SUBCMD_SET_END
);

SHELL_CMD_REGISTER(np, &sub_np, "Naughty Platypus lab commands", NULL);

static void np_cdc_write(const char *s)
{
#if DT_NODE_HAS_STATUS(DT_NODELABEL(board_cdc_acm_uart), okay)
    const struct device *dev = DEVICE_DT_GET(DT_NODELABEL(board_cdc_acm_uart));

    if (!device_is_ready(dev) || s == NULL) {
        return;
    }

#if defined(CONFIG_UART_LINE_CTRL)
    uint32_t dtr = 0;

    for (int i = 0; i < 40; i++) {
        if (uart_line_ctrl_get(dev, UART_LINE_CTRL_DTR, &dtr) == 0 && dtr) {
            break;
        }
        k_sleep(K_MSEC(50));
    }
#endif

    while (*s) {
        uart_poll_out(dev, (unsigned char)*s++);
    }
#else
    ARG_UNUSED(s);
#endif
}

static void np_cdc_write_u32(const char *prefix, uint32_t value, const char *suffix)
{
    char buf[128];

    snprintk(buf, sizeof(buf), "%s%u%s", prefix, value, suffix);
    np_cdc_write(buf);
}

static int cmd_np_version_oneword(const struct shell *sh, size_t argc, char **argv)
{
    ARG_UNUSED(argc);
    ARG_UNUSED(argv);

    shell_print(sh, "{\"type\":\"version\",\"app\":\"naughty-platypus\",\"build\":\"%s\",\"mode\":\"active_ble_survey\"}", NP_FIRMWARE_BUILD);
    return 0;
}

static int cmd_np_status_oneword(const struct shell *sh, size_t argc, char **argv)
{
    ARG_UNUSED(sh);
    ARG_UNUSED(argc);
    ARG_UNUSED(argv);

    return np_passive_survey_status();
}

static int cmd_np_survey_oneword(const struct shell *sh, size_t argc, char **argv)
{
    ARG_UNUSED(sh);
    ARG_UNUSED(argc);
    ARG_UNUSED(argv);

    np_passive_survey_drain();
    return np_passive_survey_status();
}

static int cmd_np_scan_oneword(const struct shell *sh, size_t argc, char **argv)
{
    ARG_UNUSED(sh);
    ARG_UNUSED(argc);
    ARG_UNUSED(argv);

    return np_passive_survey_start();
}

static int cmd_np_stop_oneword(const struct shell *sh, size_t argc, char **argv)
{
    ARG_UNUSED(sh);
    ARG_UNUSED(argc);
    ARG_UNUSED(argv);

    return np_passive_survey_stop();
}

static int cmd_np_reset_oneword(const struct shell *sh, size_t argc, char **argv)
{
    ARG_UNUSED(sh);
    ARG_UNUSED(argc);
    ARG_UNUSED(argv);

    return np_passive_survey_reset();
}

static int cmd_np_active_oneword(const struct shell *sh, size_t argc, char **argv)
{
    ARG_UNUSED(sh);
    ARG_UNUSED(argc);
    ARG_UNUSED(argv);

    return np_passive_survey_set_active();
}

static int cmd_np_passive_oneword(const struct shell *sh, size_t argc, char **argv)
{
    ARG_UNUSED(sh);
    ARG_UNUSED(argc);
    ARG_UNUSED(argv);

    return np_passive_survey_set_passive();
}

static int cmd_np_mode_oneword(const struct shell *sh, size_t argc, char **argv)
{
    ARG_UNUSED(sh);
    ARG_UNUSED(argc);
    ARG_UNUSED(argv);

    return np_passive_survey_mode_status();
}

static int cmd_np_splash_oneword(const struct shell *sh, size_t argc, char **argv)
{
    ARG_UNUSED(sh);
    ARG_UNUSED(argc);
    ARG_UNUSED(argv);

    return np_boot_splash_show();
}

static int cmd_np_commands_oneword(const struct shell *sh, size_t argc, char **argv)
{
    ARG_UNUSED(argc);
    ARG_UNUSED(argv);

    shell_print(sh, "version");
    shell_print(sh, "status");
    shell_print(sh, "survey");
    shell_print(sh, "scan");
    shell_print(sh, "stop");
    shell_print(sh, "reset");
    shell_print(sh, "commands");
    shell_print(sh, "active");
    shell_print(sh, "passive");
    shell_print(sh, "mode");
    shell_print(sh, "splash");
    return 0;
}

SHELL_CMD_REGISTER(version, NULL, "Show Naughty Platypus firmware version.", cmd_np_version_oneword);
SHELL_CMD_REGISTER(status, NULL, "Show BLE survey counters.", cmd_np_status_oneword);
SHELL_CMD_REGISTER(survey, NULL, "Drain BLE queue and show counters.", cmd_np_survey_oneword);
SHELL_CMD_REGISTER(scan, NULL, "Start BLE survey.", cmd_np_scan_oneword);
SHELL_CMD_REGISTER(stop, NULL, "Stop BLE survey.", cmd_np_stop_oneword);
SHELL_CMD_REGISTER(reset, NULL, "Reset BLE survey counters.", cmd_np_reset_oneword);
SHELL_CMD_REGISTER(commands, NULL, "List one-word Naughty Platypus commands.", cmd_np_commands_oneword);
SHELL_CMD_REGISTER(active, NULL, "Use active BLE scan mode for scan-response names.", cmd_np_active_oneword);
SHELL_CMD_REGISTER(passive, NULL, "Use passive BLE scan mode.", cmd_np_passive_oneword);
SHELL_CMD_REGISTER(mode, NULL, "Show active/passive scan mode.", cmd_np_mode_oneword);
SHELL_CMD_REGISTER(splash, NULL, "Redraw the optional TFT boot splash.", cmd_np_splash_oneword);

int main(void)
{
    int err;

#if defined(CONFIG_USB_DEVICE_STACK)
    err = usb_enable(NULL);
    if (err && err != -EALREADY) {
        printk("{\"type\":\"error\",\"where\":\"usb_enable\",\"err\":%d}\n", err);
    }
#endif

    /* Optional and non-fatal: BLE survey boot continues without a TFT. */
    (void)np_boot_splash_show();

    np_cdc_write("\r\n{\"type\":\"serial_boot\",\"app\":\"naughty-platypus\",\"path\":\"direct_cdc\"}\r\n");
    np_cdc_write("{\"type\":\"firmware_marker\",\"build\":\"" NP_FIRMWARE_BUILD "\"}\r\n");

    printk("\n");
    printk("Naughty Platypus Ubertooth-Style BLE Lab Suite\n");
    printk("{\"type\":\"boot\",\"app\":\"naughty-platypus\",\"role\":\"active_ble_lab_suite\"}\n");

    err = bt_enable(NULL);
    if (err) {
        printk("{\"type\":\"error\",\"where\":\"bt_enable\",\"err\":%d}\n", err);
        return 0;
    }

    bt_ready = true;

    printk("{\"type\":\"status\",\"bluetooth\":\"ready\",\"hint\":\"run commands, mode, status, splash, or survey\"}\n");

    int scan_err = np_passive_survey_start();
    np_cdc_write_u32("{\"path\":\"direct_cdc\",\"type\":\"scan_start\",\"err\":", scan_err, "}\r\n");

    /* auto_survey_status_loop: print counters without needing shell RX */
    while (1) {
        k_sleep(K_SECONDS(3));
        np_passive_survey_drain();
        np_passive_survey_status();
    }

    return 0;
}
```

## src/boot_splash.c
```c
#include <errno.h>
#include <stdbool.h>
#include <stddef.h>
#include <stdint.h>

#include <zephyr/device.h>
#include <zephyr/devicetree.h>
#include <zephyr/drivers/display.h>
#include <zephyr/drivers/gpio.h>
#include <zephyr/init.h>
#include <zephyr/kernel.h>
#include <zephyr/sys/printk.h>
#include <zephyr/sys/util.h>

#include "boot_splash.h"
#include "boot_splash_image.h"

#define NP_SPLASH_ROWS_PER_WRITE 8U
#define NP_TFT_POWER_INIT_PRIORITY 70

struct np_base64_reader {
    size_t position;
    uint32_t accumulator;
    uint8_t bits;
};

struct np_packbits_reader {
    struct np_base64_reader base64;
    uint16_t remaining;
    uint8_t repeated_value;
    bool repeated_run;
    size_t produced;
};

static int np_base64_value(char c)
{
    if (c >= 'A' && c <= 'Z') {
        return c - 'A';
    }
    if (c >= 'a' && c <= 'z') {
        return c - 'a' + 26;
    }
    if (c >= '0' && c <= '9') {
        return c - '0' + 52;
    }
    if (c == '+') {
        return 62;
    }
    if (c == '/') {
        return 63;
    }
    return -EINVAL;
}

static int np_base64_next_byte(struct np_base64_reader *reader, uint8_t *value)
{
    while (reader->bits < 8U) {
        int decoded;
        char c;

        if (reader->position >= np_boot_splash_packbits_b64_len) {
            return -ENODATA;
        }

        c = np_boot_splash_packbits_b64[reader->position++];

        if (c == '=') {
            return -ENODATA;
        }

        decoded = np_base64_value(c);
        if (decoded < 0) {
            return decoded;
        }

        reader->accumulator = (reader->accumulator << 6) | (uint32_t)decoded;
        reader->bits += 6U;
    }

    reader->bits -= 8U;
    *value = (uint8_t)((reader->accumulator >> reader->bits) & 0xffU);

    if (reader->bits == 0U) {
        reader->accumulator = 0U;
    } else {
        reader->accumulator &= BIT_MASK(reader->bits);
    }

    return 0;
}

static int np_packbits_next_index(struct np_packbits_reader *reader, uint8_t *index)
{
    int err;

    while (reader->remaining == 0U) {
        uint8_t control;

        err = np_base64_next_byte(&reader->base64, &control);
        if (err != 0) {
            return err;
        }

        if (control <= 127U) {
            reader->remaining = (uint16_t)control + 1U;
            reader->repeated_run = false;
        } else if (control >= 129U) {
            reader->remaining = 257U - (uint16_t)control;
            reader->repeated_run = true;

            err = np_base64_next_byte(&reader->base64,
                                      &reader->repeated_value);
            if (err != 0) {
                return err;
            }
        } else {
            /* PackBits control byte 128 is a no-op. */
            continue;
        }
    }

    if (reader->repeated_run) {
        *index = reader->repeated_value;
    } else {
        err = np_base64_next_byte(&reader->base64, index);
        if (err != 0) {
            return err;
        }
    }

    reader->remaining--;
    reader->produced++;
    return 0;
}

#if defined(CONFIG_NP_BOOT_SPLASH) && DT_HAS_CHOSEN(zephyr_display)

#define NP_DISPLAY_NODE DT_CHOSEN(zephyr_display)
static const struct device *const np_display = DEVICE_DT_GET(NP_DISPLAY_NODE);

#if DT_HAS_ALIAS(tft_en)
static const struct gpio_dt_spec np_tft_enable =
    GPIO_DT_SPEC_GET(DT_ALIAS(tft_en), gpios);
#define NP_HAS_TFT_ENABLE 1
#else
#define NP_HAS_TFT_ENABLE 0
#endif

#if DT_HAS_ALIAS(tft_led_en)
static const struct gpio_dt_spec np_tft_backlight =
    GPIO_DT_SPEC_GET(DT_ALIAS(tft_led_en), gpios);
#define NP_HAS_TFT_BACKLIGHT 1
#else
#define NP_HAS_TFT_BACKLIGHT 0
#endif

/*
 * The board's ST7789V driver initializes before main(). Power must therefore
 * be enabled before CONFIG_DISPLAY_INIT_PRIORITY (85 by default). Failure here
 * is deliberately non-fatal because the display is optional hardware.
 */
static int np_boot_splash_power_early(void)
{
#if NP_HAS_TFT_BACKLIGHT
    if (gpio_is_ready_dt(&np_tft_backlight)) {
        (void)gpio_pin_configure_dt(&np_tft_backlight, GPIO_OUTPUT_INACTIVE);
    }
#endif

#if NP_HAS_TFT_ENABLE
    if (gpio_is_ready_dt(&np_tft_enable)) {
        if (gpio_pin_configure_dt(&np_tft_enable, GPIO_OUTPUT_ACTIVE) == 0) {
            k_busy_wait(50000);
        }
    }
#endif

    return 0;
}

SYS_INIT(np_boot_splash_power_early, POST_KERNEL, NP_TFT_POWER_INIT_PRIORITY);

bool np_boot_splash_available(void)
{
    return device_is_ready(np_display);
}

int np_boot_splash_show(void)
{
    struct display_capabilities caps;
    struct np_packbits_reader decoder = {0};
    static uint16_t row_buffer[NP_BOOT_SPLASH_WIDTH * NP_SPLASH_ROWS_PER_WRITE];
    struct display_buffer_descriptor desc = {
        .width = NP_BOOT_SPLASH_WIDTH,
        .pitch = NP_BOOT_SPLASH_WIDTH,
    };
    int err;

    if (!device_is_ready(np_display)) {
        printk("{\"type\":\"display_status\",\"boot_splash\":\"skipped\","
               "\"reason\":\"display_not_ready\"}\n");
        return -ENODEV;
    }

    display_get_capabilities(np_display, &caps);

    if (caps.x_resolution != NP_BOOT_SPLASH_WIDTH ||
        caps.y_resolution != NP_BOOT_SPLASH_HEIGHT) {
        printk("{\"type\":\"display_status\",\"boot_splash\":\"skipped\","
               "\"reason\":\"resolution_mismatch\",\"width\":%u,\"height\":%u}\n",
               caps.x_resolution, caps.y_resolution);
        return -ENOTSUP;
    }

    if (caps.current_pixel_format != PIXEL_FORMAT_RGB_565) {
        printk("{\"type\":\"display_status\",\"boot_splash\":\"skipped\","
               "\"reason\":\"pixel_format_mismatch\",\"format\":%u}\n",
               caps.current_pixel_format);
        return -ENOTSUP;
    }

    /*
     * Draw while the backlight remains off so users do not see partially
     * rendered rows. The indexed image is decoded directly into a small
     * eight-row RGB565 working buffer instead of a full framebuffer.
     */
    for (uint16_t y = 0U; y < NP_BOOT_SPLASH_HEIGHT;
         y += NP_SPLASH_ROWS_PER_WRITE) {
        uint16_t rows = MIN((uint16_t)NP_SPLASH_ROWS_PER_WRITE,
                            (uint16_t)(NP_BOOT_SPLASH_HEIGHT - y));
        size_t pixel_count = (size_t)NP_BOOT_SPLASH_WIDTH * rows;

        for (size_t i = 0U; i < pixel_count; i++) {
            uint8_t palette_index;

            err = np_packbits_next_index(&decoder, &palette_index);
            if (err != 0) {
                printk("{\"type\":\"display_status\",\"boot_splash\":\"failed\","
                       "\"stage\":\"decode\",\"pixel\":%u,\"err\":%d}\n",
                       (unsigned int)decoder.produced, err);
                return err;
            }

            row_buffer[i] = np_boot_splash_palette_rgb565[palette_index];
        }

        desc.height = rows;
        desc.buf_size = pixel_count * sizeof(row_buffer[0]);

        err = display_write(np_display, 0U, y, &desc, row_buffer);
        if (err != 0) {
            printk("{\"type\":\"display_status\",\"boot_splash\":\"failed\","
                   "\"stage\":\"write\",\"row\":%u,\"err\":%d}\n", y, err);
            return err;
        }
    }

    if (decoder.produced != NP_BOOT_SPLASH_PIXEL_COUNT) {
        printk("{\"type\":\"display_status\",\"boot_splash\":\"failed\","
               "\"stage\":\"decode_count\",\"pixels\":%u}\n",
               (unsigned int)decoder.produced);
        return -EBADMSG;
    }

    err = display_blanking_off(np_display);
    if (err != 0 && err != -ENOSYS && err != -ENOTSUP) {
        printk("{\"type\":\"display_status\",\"boot_splash\":\"failed\","
               "\"stage\":\"blanking_off\",\"err\":%d}\n", err);
        return err;
    }

#if NP_HAS_TFT_BACKLIGHT
    if (gpio_is_ready_dt(&np_tft_backlight)) {
        err = gpio_pin_set_dt(&np_tft_backlight, 1);
        if (err != 0) {
            printk("{\"type\":\"display_status\",\"boot_splash\":\"failed\","
                   "\"stage\":\"backlight\",\"err\":%d}\n", err);
            return err;
        }
    }
#endif

    printk("{\"type\":\"display_status\",\"boot_splash\":\"shown\","
           "\"width\":%u,\"height\":%u}\n",
           NP_BOOT_SPLASH_WIDTH, NP_BOOT_SPLASH_HEIGHT);
    return 0;
}

#else

bool np_boot_splash_available(void)
{
    return false;
}

int np_boot_splash_show(void)
{
    printk("{\"type\":\"display_status\",\"boot_splash\":\"skipped\","
           "\"reason\":\"disabled_or_no_display_node\"}\n");
    return -ENOTSUP;
}

#endif
```

## src/boot_splash_image.c
```c
#include "boot_splash_image.h"

/*
 * Naughty Platypus artwork converted for the optional Heltec T114 display.
 * Target: ST7789V, 135 x 240, RGB565.
 *
 * The image is a 256-color palette plus PackBits-compressed palette indices,
 * base64-encoded in small include fragments. boot_splash.c decodes the stream
 * into an eight-row working buffer, avoiding a full framebuffer allocation.
 */

const uint16_t np_boot_splash_palette_rgb565[NP_BOOT_SPLASH_PALETTE_SIZE] = {
    0xfffc, 0xcf91, 0xffed, 0xf71e, 0xf7ea, 0xe7e8, 0xc70f, 0x976a,
    0xee1d, 0xf55f, 0x8dec, 0x954d, 0xe4de, 0x84cc, 0x5c82, 0x173c,
    0x0e79, 0x15f6, 0x05f6, 0x2cf0, 0x0513, 0x0554, 0x04d2, 0xb419,
    0x7bed, 0x6bc9, 0x6b4c, 0x5ba4, 0x5b09, 0x5acb, 0x52c8, 0x240b,
    0x040f, 0x0450, 0x03ce, 0x3b02, 0x0b2a, 0x036d, 0x02eb, 0xa1ff,
    0x69d2, 0x528a, 0x526a, 0x4a68, 0x4a49, 0x4a29, 0x4246, 0x4208,
    0x4208, 0x39e8, 0x39e7, 0x39a7, 0x3241, 0x31e3, 0x39c7, 0x31c4,
    0x31a7, 0x31a6, 0x31a5, 0x3186, 0x2986, 0x2985, 0x2966, 0x2945,
    0x1a43, 0x0269, 0x21c0, 0x11c3, 0x2965, 0x2963, 0x1961, 0x2945,
    0x2945, 0x2944, 0x2143, 0x1941, 0x2124, 0x2124, 0x2104, 0x2104,
    0x2104, 0x2103, 0x2104, 0x2104, 0x1902, 0x1902, 0x0900, 0x68b7,
    0x28a6, 0x18e4, 0x20c3, 0x18e3, 0x18c3, 0x18e3, 0x18e3, 0x18e3,
    0x18e3, 0x18c3, 0x18e3, 0x18c3, 0x18c3, 0x18e2, 0x18c3, 0x18c3,
    0x18c2, 0x18a3, 0x18c2, 0x18c3, 0x18c3, 0x18c3, 0x10c2, 0x10a3,
    0x10a2, 0x10a2, 0x10a2, 0x10c2, 0x10a3, 0x10a2, 0x10a2, 0x10a2,
    0x10a2, 0x10a2, 0x10a2, 0x10a2, 0x10a2, 0x10a2, 0x10a2, 0x10a2,
    0x10a2, 0x10a2, 0x10a2, 0x1082, 0x08c0, 0x00c0, 0x08a1, 0x10a2,
    0x08a1, 0x1082, 0x1082, 0x1082, 0x1082, 0x0881, 0x1082, 0x1082,
    0x1081, 0x1082, 0x1081, 0x0080, 0x1082, 0x1082, 0x1082, 0x1082,
    0x1062, 0x0862, 0x1081, 0x0881, 0x0861, 0x1081, 0x0861, 0x0861,
    0x0881, 0x0080, 0x0862, 0x0861, 0x0861, 0x0861, 0x0861, 0x0861,
    0x0861, 0x0861, 0x0861, 0x0861, 0x0861, 0x0861, 0x0861, 0x0861,
    0x0861, 0x0861, 0x0861, 0x0861, 0x0861, 0x0860, 0x0060, 0x0060,
    0x5015, 0x302e, 0x2009, 0x1824, 0x1024, 0x1004, 0x0841, 0x1001,
    0x0841, 0x0841, 0x0841, 0x0841, 0x0821, 0x0841, 0x0841, 0x0841,
    0x0841, 0x0801, 0x0841, 0x0841, 0x0841, 0x0841, 0x0841, 0x0821,
    0x0020, 0x0802, 0x0021, 0x0021, 0x0840, 0x0020, 0x0820, 0x0020,
    0x0020, 0x0020, 0x0040, 0x0020, 0x0020, 0x0020, 0x0020, 0x0020,
    0x0020, 0x0020, 0x0020, 0x0020, 0x0020, 0x0020, 0x0000, 0x0000,
    0x0000, 0x0000, 0x0000, 0x0001, 0x0001, 0x0000, 0x0000, 0x0000,
    0x0000, 0x0000, 0x0000, 0x0000, 0x0000, 0x0000, 0x0000, 0x0000,
    0x0040, 0x0020, 0x0000, 0x0000, 0x0000, 0x0000, 0x0000, 0x0000,
};

const char np_boot_splash_packbits_b64[] =
#include "boot_splash_data_00.inc"
#include "boot_splash_data_01.inc"
#include "boot_splash_data_02.inc"
#include "boot_splash_data_03.inc"
#include "boot_splash_data_04.inc"
#include "boot_splash_data_05.inc"
#include "boot_splash_data_06.inc"
#include "boot_splash_data_07.inc"
    ;

const size_t np_boot_splash_packbits_b64_len =
    sizeof(np_boot_splash_packbits_b64) - 1U;
```

## src/boot_splash_image.h
```c
#ifndef NAUGHTY_PLATYPUS_BOOT_SPLASH_IMAGE_H
#define NAUGHTY_PLATYPUS_BOOT_SPLASH_IMAGE_H

#include <stddef.h>
#include <stdint.h>

#define NP_BOOT_SPLASH_WIDTH  135U
#define NP_BOOT_SPLASH_HEIGHT 240U
#define NP_BOOT_SPLASH_PALETTE_SIZE 256U
#define NP_BOOT_SPLASH_PIXEL_COUNT (NP_BOOT_SPLASH_WIDTH * NP_BOOT_SPLASH_HEIGHT)

extern const uint16_t np_boot_splash_palette_rgb565[NP_BOOT_SPLASH_PALETTE_SIZE];
extern const char np_boot_splash_packbits_b64[];
extern const size_t np_boot_splash_packbits_b64_len;

#endif
```

## src/passive_survey.c
```c
#include <ctype.h>
#include <errno.h>
#include <stdio.h>
#include <string.h>

#include <zephyr/kernel.h>
#include <zephyr/sys/printk.h>
#include <zephyr/sys/util.h>
#include <zephyr/bluetooth/bluetooth.h>
#include <zephyr/bluetooth/gap.h>
#include <zephyr/bluetooth/addr.h>

#include "passive_survey.h"

#define HEX_PREVIEW_BYTES 24
#define NAME_MAX_LEN      48
#define HEX_MAX_LEN       ((HEX_PREVIEW_BYTES * 2) + 1)

struct parsed_ad {
    char name[NAME_MAX_LEN];
    char mfg_hex[HEX_MAX_LEN];
    char svc16_hex[HEX_MAX_LEN];
    uint8_t flags;
    bool has_flags;
    bool has_tx_power;
    int8_t adv_tx_power;
};

static bool survey_running;
static bool scan_cb_registered;
static uint32_t adv_events;

#define NP_ADV_QUEUE_LEN 128

struct np_adv_record {
    bt_addr_le_t addr;
    int8_t rssi;
    uint8_t adv_type;
    uint8_t data_len;
};

K_MSGQ_DEFINE(np_adv_msgq, sizeof(struct np_adv_record), NP_ADV_QUEUE_LEN, 4);

static uint32_t queued_events;
static uint32_t dropped_events;
static uint32_t drained_events;
static uint32_t named_events;
static uint32_t mfg_events;
static uint32_t svc_events;
static int8_t strongest_rssi = -127;
static int8_t weakest_rssi = 127;

static const struct bt_le_scan_param np_scan_param = {
    .type = BT_LE_SCAN_TYPE_PASSIVE,
    .options = BT_LE_SCAN_OPT_NONE,
    .interval = 0x00A0,
    .window = 0x0030,
};

static void safe_copy_name(char *dst, size_t dst_len, const uint8_t *src, uint8_t src_len)
{
    size_t n = MIN((size_t)src_len, dst_len - 1);

    for (size_t i = 0; i < n; i++) {
        char c = (char)src[i];

        if (c == '"' || c == '\\') {
            dst[i] = '_';
        } else if (isprint((unsigned char)c)) {
            dst[i] = c;
        } else {
            dst[i] = '.';
        }
    }

    dst[n] = '\0';
}

static void hex_preview(char *dst, size_t dst_len, const uint8_t *src, uint8_t src_len)
{
    static const char hex[] = "0123456789abcdef";
    size_t n = MIN((size_t)src_len, (dst_len - 1) / 2);
    size_t out = 0;

    for (size_t i = 0; i < n; i++) {
        dst[out++] = hex[(src[i] >> 4) & 0x0f];
        dst[out++] = hex[src[i] & 0x0f];
    }

    dst[out] = '\0';
}

static bool parse_ad_cb(struct bt_data *data, void *user_data)
{
    struct parsed_ad *parsed = user_data;

    switch (data->type) {
    case BT_DATA_FLAGS:
        if (data->data_len >= 1) {
            parsed->flags = data->data[0];
            parsed->has_flags = true;
        }
        break;

    case BT_DATA_NAME_SHORTENED:
    case BT_DATA_NAME_COMPLETE:
        if (parsed->name[0] == '\0' || data->type == BT_DATA_NAME_COMPLETE) {
            safe_copy_name(parsed->name, sizeof(parsed->name),
                           data->data, data->data_len);
        }
        break;

    case BT_DATA_TX_POWER:
        if (data->data_len >= 1) {
            parsed->adv_tx_power = (int8_t)data->data[0];
            parsed->has_tx_power = true;
        }
        break;

    case BT_DATA_MANUFACTURER_DATA:
        if (parsed->mfg_hex[0] == '\0') {
            hex_preview(parsed->mfg_hex, sizeof(parsed->mfg_hex),
                        data->data, data->data_len);
        }
        break;

    case BT_DATA_SVC_DATA16:
        if (parsed->svc16_hex[0] == '\0') {
            hex_preview(parsed->svc16_hex, sizeof(parsed->svc16_hex),
                        data->data, data->data_len);
        }
        break;

    default:
        break;
    }

    return true;
}

static const char *phy_to_str(uint8_t phy)
{
    switch (phy) {
    case BT_GAP_LE_PHY_1M:
        return "1M";
    case BT_GAP_LE_PHY_2M:
        return "2M";
    case BT_GAP_LE_PHY_CODED:
        return "CODED";
    default:
        return "unknown";
    }
}

static void scan_recv(const struct bt_le_scan_recv_info *info, struct net_buf_simple *buf)
{
    struct np_adv_record rec = {0};

    adv_events++;

    if (info == NULL || info->addr == NULL) {
        return;
    }

    rec.addr = *info->addr;
    rec.rssi = info->rssi;
    rec.adv_type = info->adv_type;
    rec.data_len = buf ? (buf->len > 255U ? 255U : (uint8_t)buf->len) : 0U;

    if (info->rssi > strongest_rssi) {
        strongest_rssi = info->rssi;
    }

    if (info->rssi < weakest_rssi) {
        weakest_rssi = info->rssi;
    }

    if (k_msgq_put(&np_adv_msgq, &rec, K_NO_WAIT) == 0) {
        queued_events++;
    } else {
        dropped_events++;
    }
}

static struct bt_le_scan_cb np_scan_callbacks = {
    .recv = scan_recv,
};


static void scan_recv_legacy(const bt_addr_le_t *addr,
                             int8_t rssi,
                             uint8_t adv_type,
                             struct net_buf_simple *buf)
{
    static uint32_t legacy_count;

    ARG_UNUSED(addr);
}

int np_passive_survey_start(void)
{
    int err;

    if (!scan_cb_registered) {
        printk("{\"type\":\"scan_diag\",\"step\":\"register_cb\"}\n");
        bt_le_scan_cb_register(&np_scan_callbacks);
        scan_cb_registered = true;
    }

    if (survey_running) {
        return 0;
    }

    printk("{\"type\":\"scan_diag\",\"step\":\"start\",\"scan_type\":%u,\"interval\":%u,\"window\":%u}\n",
           np_scan_param.type, np_scan_param.interval, np_scan_param.window);
    err = bt_le_scan_start(&np_scan_param, NULL);
    if (err == 0) {
        survey_running = true;
        printk("{\"type\":\"status\",\"tool\":\"ble_passive_survey\",\"scan\":\"on\"}\n");
    }

    return err;
}

int np_passive_survey_stop(void)
{
    int err;

    if (!survey_running) {
        return 0;
    }

    err = bt_le_scan_stop();
    if (err == 0) {
        survey_running = false;
        printk("{\"type\":\"status\",\"tool\":\"ble_passive_survey\",\"scan\":\"off\"}\n");
    }

    return err;
}


int np_passive_survey_drain(void)
{
    struct np_adv_record rec;
    char addr[BT_ADDR_LE_STR_LEN];
    uint32_t drained_now = 0U;

    while (k_msgq_get(&np_adv_msgq, &rec, K_NO_WAIT) == 0) {
        bt_addr_le_to_str(&rec.addr, addr, sizeof(addr));
        drained_events++;
        drained_now++;

        printk("{\"type\":\"adv_summary\","
               "\"addr\":\"%s\","
               "\"rssi\":%d,"
               "\"adv_type\":%u,"
               "\"data_len\":%u,"
               "\"drained_events\":%u}\n",
               addr,
               rec.rssi,
               rec.adv_type,
               rec.data_len,
               drained_events);

        /* Keep serial output bounded so BLE/USB stays stable. */
        if (drained_now >= 32U) {
            break;
        }
    }

    return (int)drained_now;
}

int np_passive_survey_status(void)
{
    printk("{\"type\":\"survey_status\","
           "\"scanning\":%s,"
           "\"adv_events\":%u,"
           "\"named_events\":%u,"
           "\"mfg_events\":%u,"
           "\"svc_events\":%u,"
           "\"strongest_rssi\":%d,"
           "\"weakest_rssi\":%d}\n",
           survey_running ? "true" : "false",
           adv_events,
           named_events,
           mfg_events,
           svc_events,
           strongest_rssi,
           weakest_rssi);

    printk("{\"type\":\"queue_status\","
           "\"queued_events\":%u,"
           "\"dropped_events\":%u,"
           "\"drained_events\":%u,"
           "\"pending\":%u}\n",
           queued_events,
           dropped_events,
           drained_events,
           k_msgq_num_used_get(&np_adv_msgq));

    return 0;
}

int np_passive_survey_reset(void)
{
    adv_events = 0;
    queued_events = 0;
    dropped_events = 0;
    drained_events = 0;
    k_msgq_purge(&np_adv_msgq);
    named_events = 0;
    mfg_events = 0;
    svc_events = 0;
    strongest_rssi = -127;
    weakest_rssi = 127;

    printk("{\"type\":\"status\",\"tool\":\"ble_passive_survey\",\"stats\":\"reset\"}\n");
    return 0;
}

bool np_passive_survey_is_running(void)
{
    return survey_running;
}
```

## src/passive_survey.h
```c
#ifndef NAUGHTY_PLATYPUS_PASSIVE_SURVEY_H
#define NAUGHTY_PLATYPUS_PASSIVE_SURVEY_H

#include <stdbool.h>

int np_passive_survey_start(void);
int np_passive_survey_stop(void);
int np_passive_survey_status(void);
int np_passive_survey_reset(void);
int np_passive_survey_drain(void);
int np_passive_survey_set_active(void);
int np_passive_survey_set_passive(void);
int np_passive_survey_mode_status(void);
bool np_passive_survey_is_running(void);

#endif
```
